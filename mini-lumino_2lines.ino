#include <LEDMatrixDriver.hpp>

// This sketch draw marquee text on your LED matrix using the hardware SPI driver Library by Bartosz Bielawski.
// Example written 16.06.2017 by Marko Oette, www.oette.info 

// Define the ChipSelect pin for the led matrix (Dont use the SS or MISO pin of your Arduino!)
// Other pins are arduino specific SPI pins (MOSI=DIN of the LEDMatrix and CLK) see https://www.arduino.cc/en/Reference/SPI
const uint8_t LEDMATRIX_CS_PIN = 15;

// Define LED Matrix dimensions (0-n) - eg: 32x8 = 31x7
const int LEDMATRIX_WIDTH = 64;  
const int LEDMATRIX_HEIGHT = 7+8;
const int LEDMATRIX_SEGMENTS = 16;
const int LEDMATRIX_TOTAL_PIXEL = 64*16;

boolean bold = true;


// The LEDMatrixDriver class instance
LEDMatrixDriver lmd(LEDMATRIX_SEGMENTS, LEDMATRIX_CS_PIN);

void setup() {
  // init the display
  lmd.setEnabled(true);
  lmd.setIntensity(1);   // 0 = low, 10 = high
}

int x=0, y=0;   // start top left

// This is the font definition. You can use http://gurgleapps.com/tools/matrix to create your own font or sprites.
// If you like the font feel free to use it. I created it myself and donate it to the public domain.
byte font_regular[95][8] = { {0,0,0,0,0,0,0,0}, // SPACE
                     {0x10,0x18,0x18,0x18,0x18,0x00,0x18,0x18}, // EXCL
                     {0x28,0x28,0x08,0x00,0x00,0x00,0x00,0x00}, // QUOT
                     {0x00,0x0a,0x7f,0x14,0x28,0xfe,0x50,0x00}, // #
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                     {0x00,0x66,0xff,0xff,0xff,0x7e,0x3c,0x18}, // <3
                      // (the font does not contain any lower case letters. you can add your own.)
                  };    // {}, //
  
  byte font_bold[95][8] = { {0,0,0,0,0,0,0,0}, // SPACE
                     {0x10,0x18,0x18,0x18,0x18,0x00,0x18,0x18}, // EXCL
                     {0x28,0x28,0x08,0x00,0x00,0x00,0x00,0x00}, // QUOT
                     {0x00,0x0a,0x7f,0x14,0x28,0xfe,0x50,0x00}, // #
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                     {0x00,0x66,0xff,0xff,0xff,0x7e,0x3c,0x18}, // <3
                      // (the font does not contain any lower case letters. you can add your own.)
                  };

// Marquee speed
const int ANIM_DELAY = 100;

// Marquee text 
//char[] = "** LED MATRIX DEMO! ** (1234567890) ++ \"ABCDEFGHIJKLMNOPQRSTUVWXYZ\" ++ <$%/=?'.@,> --";
char* text = "";


void loop() 
{
 // Draw the text to the current position
  int len = 0;


  text = "[ SUSE [";
  len = strlen(text);
  drawLine(text, len, 0, 1);


  text = "[[[[[[[[";
  len = strlen(text);
  drawLine(text, len, 1, 1);


  /*
  text = " I[SUSE";
  len = strlen(text);
  drawLine(text, len, 1);
*/



   // In case you wonder why we don't have to call lmd.clear() in every loop: The font has a opaque (black) background...
  // setPixel(63,8,1);
   //lmd.setPixel(64,0,1);
   

 // Toggle display of the new framebuffer
 lmd.display();
 // set_All();
 // randomize(0);
 // Wait to let the human read the display
 delay(ANIM_DELAY);

 // Advance to next coordinate
 //if( --x < len * -8 )
 //  x = LEDMATRIX_WIDTH;
}

void clear_All(){
  for(int i=0;i<128;i++){
    for(int j=0;j<8;j++){
      lmd.setPixel(i, j, 0);
    }
  }
  lmd.display();
}

void set_All(){
  for(int i=0;i<128;i++){
    for(int j=0;j<8;j++){
      lmd.setPixel(i, j, 1);
    }
  }
  lmd.display();
}

void randomize(int state) {
  for (int i = 0; i<=LEDMATRIX_TOTAL_PIXEL; i++) {
    int y_pixel = rand() % 8;
    int x_pixel = rand() % 128;
    lmd.setPixel(x_pixel, y_pixel, state);
    lmd.display();

  }
}

void setPixel(int x, int y, bool value) {
  int real_x = 0;
  int real_y = 0;
  //real_x = (((int)(y/8))*64)+x;
  //real_y = y - (((int)(y/8))*8);

  if (y < 8) {
    real_x = x;
    real_y = y;
  } else {
    real_x = 64 + x;
    real_y = y - 8;
  }
  lmd.setPixel(real_x, real_y, value);
}

void drawLine(char* text, int len, int line, boolean bold) {

  drawString(text, len, 0, 8*line, bold);
}

/**
 * This function draws a string of the given length to the given position.
 */
void drawString(char* text, int len, int x, int y, boolean bold )
{
 // byte *font[95] = bold ? &font_bold : &font_regular;
  for( int idx = 0; idx < len; idx ++ )
  {
    int c = text[idx] - 32;

    // stop if char is outside visible area
    if( x + idx * 8  > LEDMATRIX_WIDTH-1 )
      return;
    
    // only draw if char is visible
    if( 8 + x + idx * 8 > 0 ) {
      if (bold) {
        drawSprite( font_bold[c], x + idx * 8, y, 8, 8 );
      }
     else {
        drawSprite( font_regular[c], x + idx * 8, y, 8, 8 );
      }
    }
      
  }
}

/**
 * This draws a sprite to the given position using the width and height supplied (usually 8x8)
 */
void drawSprite( byte* sprite, int x, int y, int width, int height )
{
  // The mask is used to get the column bit from the sprite row
  byte mask = B10000000;
  
  for( int iy = 0; iy < height; iy++ )
  {
    for( int ix = 0; ix < width; ix++ )
    {
      setPixel(x + ix, y + iy, (bool)(sprite[iy] & mask ));

      // shift the mask by one pixel to the right
      mask = mask >> 1;
    }

    // reset column mask
    mask = B10000000;
  }
}


